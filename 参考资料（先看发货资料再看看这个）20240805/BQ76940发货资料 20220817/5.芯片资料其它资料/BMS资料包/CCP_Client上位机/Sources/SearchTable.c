
#include "SearchTable.h"
#include "Type.h"

TemptureTable* g_pstSearchTableData;
UINT8 g_ubSearchTableInit=0;

void SearchTable_vInit( )
{
	static TemptureTable table[]={
{-30,3722},
{-29,3716},
{-28,3711},
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{110,723}
		};
  g_pstSearchTableData=table;
  g_ubSearchTableInit=1;
}
INT16 SearchTable_iGetTempture ( UINT16 ADCValue)
{
	UINT8 i;
	
  if(g_ubSearchTableInit==0) 
  {
     SearchTable_vInit();
  }

	if(ADCValue>3722)
	return -35;
	
	if(ADCValue<723)
	return 120;
	
  if(ADCValue>=2474) 
  {
    for(i=1;i<=71;i++) 
    {
      if(g_pstSearchTableData[i].value<=ADCValue&&ADCValue<=g_pstSearchTableData[i-1].value)
        return g_pstSearchTableData[i].tempture;
    }
  
  } 
  if(ADCValue<2474) 
  {
    for(i=71;i<=140;i++) 
    {
      if(g_pstSearchTableData[i].value<=ADCValue&&ADCValue<=g_pstSearchTableData[i-1].value)
        return g_pstSearchTableData[i].tempture;
    }
  }
  return 45;
}

